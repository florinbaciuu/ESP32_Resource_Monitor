## sdkconfig.defaults
```kconfig
CONFIG_ESP_RESOURCE_MONITOR_ENABLED=y

CONFIG_ESP_TIMER_PROFILING=y
CONFIG_ESP_TIME_FUNCS_USE_RTC_TIMER=y
CONFIG_ESP_TIME_FUNCS_USE_ESP_TIMER=y
CONFIG_ESP_TIMER_TASK_STACK_SIZE=4096
CONFIG_ESP_TIMER_INTERRUPT_LEVEL=1
CONFIG_ESP_TIMER_TASK_AFFINITY=0x0
CONFIG_ESP_TIMER_TASK_AFFINITY_CPU0=y
CONFIG_ESP_TIMER_ISR_AFFINITY_CPU0=y
CONFIG_ESP_TIMER_IMPL_SYSTIMER=y

CONFIG_FREERTOS_CORETIMER_SYSTIMER_LVL1=y
CONFIG_FREERTOS_RUN_TIME_STATS_USING_ESP_TIMER=y
```
